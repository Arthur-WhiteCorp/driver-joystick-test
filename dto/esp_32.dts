/dts-v1/;
/plugin/;

/ {
	fragment@0 {
		target-path = "/soc";
		__overlay__ {
		joystick_gpio: joystick-gpio@0 {
				compatible = "equipe03,esp32_joystick";
				latch-gpios = <&gpio 17 0>;
				clk-gpios   = <&gpio 27 0>;
				data-gpios  = <&gpio 22 0>;
				message = "Have a good life";
				status = "okay";
			};
		};
	};
	__overrides__ {
        latch_pin = <&joystick_gpio>, "latch-gpios:4";
        clk_pin   = <&joystick_gpio>, "clk-gpios:4";
        data_pin  = <&joystick_gpio>, "data-gpios:4";
    };
};
